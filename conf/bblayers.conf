## conf/bblayers.conf
```bitbake
LCONF_VERSION = "6"

BBPATH = "${TOPDIR}"
DEMODIR := "${@os.path.abspath(os.path.dirname(d.getVar('FILE', True)) + '/../..')}"

BBFILES ?= ""
BBLAYERS = " \
  ${DEMODIR}/sources/poky/meta \
  ${DEMODIR}/sources/poky/meta-poky \
  ${DEMODIR}/sources/meta-openembedded/meta-oe \
  ${DEMODIR}/sources/meta-arm/meta-arm-toolchain \
  \
"
```
